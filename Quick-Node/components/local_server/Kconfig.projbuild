## Quick-Node/components/local_server/Kconfig.projbuild
```kconfig
menu "LOCAL SERVER CONFIGURATION"
	config WS_MAX_CONN
        int "Maximal Websocket connections"
        default 1
        help
        	Maximun number of websocket clients.
endmenu
```

## Quick-Node/components/wifi_controller/Kconfig.projbuild
```kconfig
menu "WIFI CONTROLLER CONFIGURATION"

    config AP_WIFI_SSID
        string "Access Point WiFi SSID"
        default "Quick-Node#"
        help
            SSID (network name) for the example to connect to.

    config AP_WIFI_PASSWORD
        string "Access Point WiFi Password"
        default "12345678"
        help
            WiFi password (WPA or WPA2) for the example to use.
    config AP_WIFI_CHANNEL
        int "Access Point Wifi Channel"
        default 1
        help
            Wifi Channel for AP.        
	config AP_MAX_STA_CONN
        int "Maximal STA connections"
        default 1
        help
            Max number of the STA connects to AP.
	
endmenu
```

## Quick-Trigger/components/local_server/Kconfig.projbuild
```kconfig
menu "LOCAL SERVER CONFIGURATION"

    config LOCAL_SERVER_MDNS_HOST_NAME
        string "mDNS Host Name"
        default "http://subsuelo3d.quick/"
        help
            Specify the domain name used in the mDNS service.
            Note that webpage also take it as a part of URL where it will send GET/POST requests to.

    config HTTP_SERVER_WEB_MOUNT_POINT
        string "Website mount point in VFS"
        default "/storage"
        help
            Specify the mount point in VFS.
            
	config WS_MAX_CONN
        int "Maximal Websocket connections"
        default 2
        help
        	Maximuin number of websocket clients allowed.
endmenu
```

## Quick-Trigger/components/uart_controller/Kconfig.projbuild
```kconfig
menu "UART CONTROLLER CONFIGURATION"
    config UART_PORT_NUM
        int "UART port number"
        range 0 2 if IDF_TARGET_ESP32   || IDF_TARGET_ESP32S3
        range 0 1 if IDF_TARGET_ESP32S2 || IDF_TARGET_ESP32C3
        default 2 if IDF_TARGET_ESP32   || IDF_TARGET_ESP32S3
        default 1 if IDF_TARGET_ESP32S2 || IDF_TARGET_ESP32C3
        help
            UART communication port number for the example.
            See UART documentation for available port numbers.

    config UART_BAUD_RATE
        int "UART communication speed"
        default 115200
        help
            UART communication speed for Modbus example.

    config UART_RXD
        int "UART RXD pin number"
        range 0 34 if IDF_TARGET_ESP32
        range 0 46 if IDF_TARGET_ESP32S2 || IDF_TARGET_ESP32S3
        range 0 19 if IDF_TARGET_ESP32C3
        default 5
        help
            GPIO number for UART RX pin. See UART documentation for more information
            about available pin numbers for UART.

    config UART_TXD
        int "UART TXD pin number"
        range 0 34 if IDF_TARGET_ESP32
        range 0 46 if IDF_TARGET_ESP32S2 || IDF_TARGET_ESP32S3
        range 0 19 if IDF_TARGET_ESP32C3
        default 4
        help
            GPIO number for UART TX pin. See UART documentation for more information
            about available pin numbers for UART.
endmenu
```

## Quick-Trigger/components/websocket_client/Kconfig.projbuild
```kconfig
menu "WEBSOCKET CLIENT CONFIGURATION"
    config WEBSOCKET_URI
        string "Websocket endpoint URI"
        default "ws://{ip}:{port}/{path}"
        help
            URL of websocket endpoint this example connects to and sends echo.
endmenu
```

## Quick-Trigger/components/wifi_controller/Kconfig.projbuild
```kconfig
menu "WIFI CONTROLLER CONFIGURATION"

    config AP_WIFI_SSID
        string "Access Point WiFi SSID"
        default "Quick-Trigger"
        help
            SSID (network name) for the example to connect to.

    config AP_WIFI_PASSWORD
        string "Access Point WiFi Password"
        default "12345678"
        help
            WiFi password (WPA or WPA2) for the example to use.
    config AP_WIFI_CHANNEL
        int "Access Point Wifi Channel"
        default 1
        help
            Wifi Channel for AP.        
	config AP_MAX_STA_CONN
        int "Maximal STA connections"
        default 1
        help
            Max number of the STA connects to AP.
    config STA_WIFI_SSID
        string "Station WiFi SSID"
        default "stationSSID"
        help
            SSID (network name) for the trigger to connect to.

    config STA_WIFI_PASSWORD
        string "Station WiFi Password"
        default "password"
        help
            WiFi password (WPA or WPA2) for the example to use.    
    config STA_MAXIMUM_RETRY
        int "Maximum retry"
        default 5
        help
            Set the Maximum retry to avoid station reconnecting to the AP unlimited when the AP is really inexistent.
	config NETWORK_SCAN_LIST_SIZE
        int "Max size of scan list"
        range 0 20
        default 10
        help
            The size of array that will be used to retrieve the list of access points.
	
endmenu
```
